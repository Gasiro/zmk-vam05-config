## config/boards/arm/vam05_rev_a/Kconfig.board
```kconfig
# Copyright (c) 2020 The ZMK Contributors
# SPDX-License-Identifier: MIT

config BOARD_VAM05_REV_A
	bool "Vam05 Rev A"
	depends on SOC_NRF52840_QIAA
```

## config/boards/arm/vam05_rev_a/Kconfig.defconfig
```kconfig
# Copyright (c) 2020 The ZMK Contributors
# SPDX-License-Identifier: MIT

if BOARD_VAM05_REV_A

config ZMK_KEYBOARD_NAME
	default "Vam05 Keyboard"

if USB

config USB_NRFX
	default y

config USB_DEVICE_STACK
	default y

endif # USB

config BT_CTLR
	default BT

config ZMK_BLE
	default y

config ZMK_USB
	default y

config I2C
	default y

config MAX17048
	default y

config LED
    default y

config LED_LOCK_STATUS
    bool "Enable LED lock indicators, such as Caps lock, Num Lock ..."
    default n

endif # BOARD_VAM05_REV_A
```

## config/boards/arm/vam05_rev_a/vam05_rev_a_defconfig
```kconfig
# SPDX-License-Identifier: MIT

CONFIG_SOC_SERIES_NRF52X=y
CONFIG_SOC_NRF52840_QIAA=y
CONFIG_BOARD_VAM05_REV_A=y  

# Enable sleep, default set to 45 min (defined in ms)
CONFIG_ZMK_SLEEP=y
CONFIG_ZMK_IDLE_SLEEP_TIMEOUT=2700000

# Enable MPU
CONFIG_ARM_MPU=y

# Enable GPIO
CONFIG_GPIO=y

CONFIG_USE_DT_CODE_PARTITION=y
CONFIG_BUILD_OUTPUT_UF2=y

# Enable pwm
CONFIG_PWM=y
CONFIG_PWM_NRFX=y

CONFIG_MPU_ALLOW_FLASH_WRITE=y
CONFIG_NVS=y
CONFIG_SETTINGS_NVS=y
CONFIG_FLASH=y
CONFIG_FLASH_PAGE_LAYOUT=y
CONFIG_FLASH_MAP=y

# Enable Underglow
CONFIG_ZMK_RGB_UNDERGLOW=y
CONFIG_WS2812_STRIP=y
CONFIG_ZMK_RGB_UNDERGLOW_EXT_POWER=y
CONFIG_ZMK_RGB_UNDERGLOW_ON_START=y

# RGB strip
CONFIG_ZMK_RGB_UNDERGLOW_HUE_START=262
CONFIG_ZMK_RGB_UNDERGLOW_EFF_START=3

# Enable pinctrl
CONFIG_PINCTRL=y

# Enable ZMK studio
CONFIG_ZMK_STUDIO=y
CONFIG_ZMK_STUDIO_LOCKING=n

# Enable BLE + USB
CONFIG_ZMK_USB=y
CONFIG_ZMK_BLE=y

# Enable I2C
CONFIG_I2C=y
CONFIG_I2C_NRFX=y

# Windows Battery Reporting Fix
CONFIG_BT_GATT_ENFORCE_SUBSCRIPTION=n

# set TX power level
# CONFIG_BT_CTLR_TX_PWR_PLUS_8=y // Recommended if used in a metal enclosure

# Turn on logging, and set ZMK logging to debug output
# CONFIG_LOG=y
# CONFIG_ZMK_USB_LOGGING=y
# CONFIG_LOG_PROCESS_THREAD_STARTUP_DELAY_MS=2500
# CONFIG_ZMK_LOG_LEVEL_DBG=y
# CONFIG_I2C_LOG_LEVEL_DBG=y
# CONFIG_SENSOR_LOG_LEVEL_DBG=y

# Enable RGB widget // layers color - (green)yellow/magenta/cyan
CONFIG_RGBLED_WIDGET=y
CONFIG_RGBLED_WIDGET_SHOW_LAYER_COLORS=y
CONFIG_RGBLED_WIDGET_LAYER_0_COLOR=0
CONFIG_RGBLED_WIDGET_LAYER_1_COLOR=3
CONFIG_RGBLED_WIDGET_LAYER_2_COLOR=5
CONFIG_RGBLED_WIDGET_LAYER_3_COLOR=6

# Capslock leds
CONFIG_ZMK_HID_INDICATORS=y
CONFIG_LED=y

# Sys leds blink interval 150ms
CONFIG_INDICATOR_LED_WIDGET=y
CONFIG_INDICATOR_LED_INTERVAL_MS=250
CONFIG_INDICATOR_LED_SHOW_BATTERY_ON_BOOT=y

# Batt led (green) - high80% blink 2 time, low20% fast blink 5 times，lower than 5% blink 10 times
CONFIG_INDICATOR_LED_SHOW_LAYER_CHANGE=n
CONFIG_INDICATOR_LED_SHOW_BLE=n
CONFIG_INDICATOR_LED_BATTERY_HIGH_BLINK_REPEAT=2
CONFIG_INDICATOR_LED_BATTERY_LOW_BLINK_REPEAT=5
CONFIG_INDICATOR_LED_BATTERY_CRITICAL_BLINK_REPEAT=10

# Three colour led indicator - turn off 3light-RGB LEDS for battery
CONFIG_RGBLED_WIDGET_BATTERY_COLOR_MISSING=0
CONFIG_RGBLED_WIDGET_BATTERY_COLOR_HIGH=0
CONFIG_RGBLED_WIDGET_BATTERY_COLOR_MEDIUM=0
CONFIG_RGBLED_WIDGET_BATTERY_COLOR_LOW=0
CONFIG_RGBLED_WIDGET_BATTERY_COLOR_LOW=0
CONFIG_RGBLED_WIDGET_BATTERY_COLOR_CRITICAL=0
```

## config/west.yml
```yaml
manifest:
  remotes:
    - name: zmkfirmware
      url-base: https://github.com/zmkfirmware
    - name: caksoylar  # <-- rgb remote add
      url-base: https://github.com/caksoylar  # <-- rgb remote add
    - name: Gasiro
      url-base: https://github.com/Gasiro
  projects:
    - name: zmk
      remote: zmkfirmware
      revision: v0.3
      import: app/west.yml
    - name: zmk-rgbled-widget  # <-- rgb remote add
      remote: caksoylar  # <-- rgb remote add
      revision: v0.2  # <-- rgb remote add
    - name: zmk-batt-led-indicator
      remote: Gasiro
      revision: v0.2
  self:
    path: config
```
